## config/west.yml
```yaml
manifest:
  remotes:
    - name: zmkfirmware
      url: https://github.com/zmkfirmware/zmk.git

  projects:
    - name: zmk
      remote: zmkfirmware
      revision: main
      import: app/west.yml

  self:
    path: config
```
